// SPDX-License-Identifier: GPL-2.0+
//
// Copyright 2012 Freescale Semiconductor, Inc.

/dts-v1/;
#include "imx28-brain.dtsi"
#include <dt-bindings/input/input.h>

/ {
	model = "SHARP Brain PW-SH5";
	compatible = "sharp,pw-sh5", "sharp,brain", "fsl,imx28";
};

&brainlcd {
	status = "okay";

	sharp,lcd-width = <854>;
	sharp,lcd-height = <480>;
	sharp,lcd-width-mm = <121>;
	sharp,lcd-height-mm = <68>;

	sharp,mac-flip-y-gs;
	sharp,mac-transpose;

	sharp,en-gpios =
		<&gpio0 26 GPIO_ACTIVE_HIGH>,
		<&gpio0 27 GPIO_ACTIVE_HIGH>,
		<&gpio4 16 GPIO_ACTIVE_HIGH>;
};

&keyboard_gpio {
	status = "okay";
	matrix-in-gpios =
		<&gpio4 0 GPIO_ACTIVE_HIGH>,
		<&gpio4 1 GPIO_ACTIVE_HIGH>,
		<&gpio4 2 GPIO_ACTIVE_HIGH>,
		<&gpio4 3 GPIO_ACTIVE_HIGH>,
		<&gpio4 4 GPIO_ACTIVE_HIGH>,
		<&gpio4 5 GPIO_ACTIVE_HIGH>,
		<&gpio4 6 GPIO_ACTIVE_HIGH>,
		<&gpio4 7 GPIO_ACTIVE_HIGH>;
	matrix-out-gpios =
		<&gpio2 16 GPIO_ACTIVE_HIGH>,
		<&gpio2 17 GPIO_ACTIVE_HIGH>,
		<&gpio2 18 GPIO_ACTIVE_HIGH>,
		<&gpio2 19 GPIO_ACTIVE_HIGH>,
		<&gpio2 20 GPIO_ACTIVE_HIGH>,
		<&gpio2 21 GPIO_ACTIVE_HIGH>,
		<&gpio4 8 GPIO_ACTIVE_HIGH>;
	symbol-key = <4 6>;
	keymap =
		/* Bank 0x01 */
		<0 6 KEY_PAGEUP>,     /* Kokugo */
		<0 0 KEY_TAB>,        /* Brain English */
		<0 5 KEY_PAGEDOWN>,   /* Eiwa Waei */
		<0 4 KEY_INSERT>,     /* My Discitonary */
		<0 3 KEY_DELETE>,     /* History */

		/* Bank 0x02 */
		<1 0 KEY_P>,          /* P */
		<1 1 KEY_O>,          /* O */
		<1 2 KEY_I>,          /* I */
		<1 3 KEY_U>,          /* U */
		<1 4 KEY_Y>,          /* Y */
		<1 5 KEY_T>,          /* T */
		<1 6 KEY_R>,          /* R */

		/* Bank 0x04 */
		<2 0 KEY_L>,          /* L */
		<2 1 KEY_K>,          /* K */
		<2 2 KEY_J>,          /* J */
		<2 3 KEY_H>,          /* H */
		<2 4 KEY_G>,          /* G */
		<2 5 KEY_F>,          /* F */
		<2 6 KEY_D>,          /* D */

		/* Bank 0x08 */
		<3 0 KEY_BACKSPACE>,  /* Backspace */
		<3 1 KEY_MINUS>,      /* Minus */
		<3 2 KEY_M>,          /* M */
		<3 3 KEY_UP>,         /* Up */
		<3 4 KEY_N>,          /* N */
		<3 5 KEY_B>,          /* B */
		<3 6 KEY_V>,          /* V */

		/* Bank 0x10 */
		<4 0 KEY_ENTER>,      /* Enter */
		<4 1 KEY_RIGHT>,      /* Right */
		<4 2 KEY_DOWN>,       /* Down */
		<4 3 KEY_LEFT>,       /* Left */
		<4 4 KEY_ESC>,        /* Go Back */
		<4 5 KEY_SPACE>,      /* Space */
		<4 6 0>,      /* Symbols (specify 0 to mark this key used) */

		/* Bank 0x20 */
		<5 0 KEY_ESC>,        /* Home */
		<5 1  KEY_Q>,         /* Q */
		<5 2 KEY_W>,          /* W */
		<5 3 KEY_E>,          /* E */
		<5 4 KEY_A>,          /* A */
		<5 5 KEY_S>,          /* S */
		<5 6 KEY_RIGHT>,      /* Right */

		/* Bank 0x40 */
		<6 0 KEY_LEFTSHIFT>,  /* Shift */
		<6 1 KEY_Z>,          /* Z */
		 <6 2 KEY_X>,         /* X */
		<6 3 KEY_C>,          /* C */
		<6 4 KEY_LEFTCTRL>,   /* PageUp */
		/* <6 5 ?> */
		<6 6 KEY_LEFTALT>;    /* Onsei */
	keymap-symbol =
		<0 6 KEY_PAGEUP>,     /* Kokugo */
		<0 0 KEY_TAB>,        /* Brain English */
		<0 5 KEY_PAGEDOWN>,   /* Eiwa Waei */
		<0 4 KEY_INSERT>,     /* My Discitonary */
		<0 3 KEY_DELETE>,     /* History */

		<1 0 KEY_0>,          /* P */
		<1 1 KEY_9>,          /* O */
		<1 2 KEY_8>,          /* I */
		<1 3 KEY_7>,          /* U */
		<1 4 KEY_6>,          /* Y */
		<1 5 KEY_5>,          /* T */
		<1 6 KEY_4>,          /* R */
		<5 3 KEY_3>,          /* E */
		<5 2 KEY_2>,          /* W */
		<5 1 KEY_1>,          /* Q */

		<2 6 KEY_GRAVE>,      /* D */
		<2 4 KEY_BACKSLASH>,  /* G */
		<2 3 KEY_SEMICOLON>,  /* H */


		<2 2 KEY_APOSTROPHE>, /* J */
		<2 1 KEY_LEFTBRACE>,  /* K */
		<2 0 KEY_RIGHTBRACE>, /* L */

		<6 0 KEY_LEFTSHIFT>,  /* Shift */
		<2 5 KEY_EQUAL>,      /* F */
		<3 4 KEY_COMMA>,      /* N */
		<3 2 KEY_DOT>,        /* M */
		<3 1 KEY_SLASH>,      /* Minus */

		<6 4 KEY_LEFTCTRL>,   /* Page Up */

		<6 6 KEY_LEFTALT>,    /* Onsei */
		<3 0 KEY_BACKSPACE>;  /* Backspace */
};
