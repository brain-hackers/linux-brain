## Documentation/devicetree/bindings/sound/rohm,bu26154.yaml
```yaml
# SPDX-License-Identifier: (GPL-2.0-only OR BSD-2-Clause)
%YAML 1.2
---
$id: http://devicetree.org/schemas/sound/rohm,bu26154.yaml#
$schema: http://devicetree.org/meta-schemas/core.yaml#

title: ROHM BU26154MUV audio codec

maintainers:
  - Ming <sharp-brain-dev@myli.page>

description: |
  Audio codec with a mono microphone ADC and an I2S interface using an
  external MCLK.
  HPVDD, HPVSS, REGOUT and VMID are generated outputs, not external supplies.

properties:
  compatible:
    const: rohm,bu26154

  reg:
    enum: [0x1a, 0x1b]

  clocks:
    maxItems: 1

  clock-names:
    const: mclk

  '#sound-dai-cells':
    description: 0 selects DAC playback; 1 selects ADC capture.
    const: 1

  HVDD-supply:
    description: Main analog and digital interface supply.

  CPVDD-supply:
    description: Headphone charge-pump supply.

  SPVDD-supply:
    description: Speaker amplifier supply.

  TVDD-supply:
    description: I/O supply.

required:
  - compatible
  - reg
  - clocks
  - clock-names
  - '#sound-dai-cells'
  - HVDD-supply
  - CPVDD-supply
  - SPVDD-supply
  - TVDD-supply

additionalProperties: false

examples:
  - |
    i2c {
        #address-cells = <1>;
        #size-cells = <0>;
        codec@1a {
            compatible = "rohm,bu26154";
            reg = <0x1a>;
            #sound-dai-cells = <1>;
            clocks = <&audio_mclk>;
            clock-names = "mclk";
            HVDD-supply = <&codec_supply>;
            CPVDD-supply = <&codec_supply>;
            SPVDD-supply = <&codec_supply>;
            TVDD-supply = <&codec_supply>;
        };
    };
```

## arch/arm/mach-tmpa9xx/Kconfig
```kconfig
# SPDX-License-Identifier: GPL-2.0-only
config ARCH_TMPA9XX
	bool "Toshiba TMPA9xx"
	depends on ARCH_MULTI_V5
	select ARM_AMBA
	select ARM_VIC
	select TMPA9XX_TIMER
	help
	  Support for Toshiba TMPA9xx ARM926EJ-S processors.
```

## sound/soc/mxs/Kconfig
```kconfig
# SPDX-License-Identifier: GPL-2.0-only
menuconfig SND_MXS_SOC
	tristate "SoC Audio for Freescale MXS CPUs"
	depends on ARCH_MXS || COMPILE_TEST
	depends on COMMON_CLK
	select SND_SOC_GENERIC_DMAENGINE_PCM
	help
	  Say Y or M if you want to add support for codecs attached to
	  the MXS SAIF interface.


if SND_MXS_SOC

config SND_SOC_MXS_SGTL5000
	tristate "SoC Audio support for MXS boards with sgtl5000"
	depends on I2C
	select SND_SOC_SGTL5000
	help
	  Say Y if you want to add support for SoC audio on an MXS board with
	  a sgtl5000 codec.

endif	# SND_MXS_SOC

config SND_SOC_MXS_SAIF_KUNIT_TEST
	tristate "KUnit tests for MXS SAIF clock configuration" if !KUNIT_ALL_TESTS
	depends on KUNIT
	default KUNIT_ALL_TESTS
	help
	  Test the MXS SAIF MCLK ratio selection and parent rate validation.
	  Exercise both clock families, invalid rates and integer overflow
	  without requiring MXS hardware. This does not emulate the controller
	  or test physical clock gating and audio transfers.

	  If unsure, say N.
```
